## components/xag_mqtt_component/Kconfig.projbuild
```kconfig
menu "MQTT Configuration"


    config USER_NAME
        string "MQTT User Name"
        default "esquare"
        help
            User name of the broker to connect to

    config PASSWORD
        string "MQTT Password"
        default "Abcd1234"
        help
            Password of the broker to connect to

                    
    config BROKER_URL
        string "Broker URL"
        default "mqtt://esquare:Abcd1234@195.35.29.48:1883"
        help
            URL of the broker to connect to

endmenu
```

## components/xag_ota_component/Kconfig.projbuild
```kconfig
menu "OTA Configuration"

    config FIRMWARE_UPGRADE_URL
        string "Firmware Upgrade URL"
        default "https://home.nudgeenergy.co.uk/ftpuser/NEMS/HUB_LORA/advanced_https_ota.bin"
        help
            URL of server which hosts the firmware image.

endmenu
```

## main/Kconfig.projbuild
```kconfig
menu "Button Conifugration"

    config MULTIBUTTON_GPIO
        int "MULTIBUTTON GPIO"
        range 0 35
        default 21
        help 
            MULTIBUTTON pin.
    config BUTTON_INC_GPIO
        int "BUTTON_INC_GPIO"
        range 0 35
        default 21
        help 
            BUTTON_INC_GPIO pin.
    config BUTTON_DEC_GPIO
        int "BUTTON_DEC_GPIO"
        range 0 35
        default 21
        help 
            BUTTON_DEC_GPIO pin.
    config RED_LED_GPIO
        int "RED LED GPIO"
        range 0 35
        default 21
        help 
            REDLE GPIO pin.

    config BLUE_LED_GPIO
        int "BLUE_LED_GPIO"
        range 0 35
        default 21
        help 
            BLUE_LED_GPIO.

    config GREEN_LED_GPIO
        int "GREEN_LED_GPIO"
        range 0 35
        default 21
        help 
            GREEN_LED_GPIO.
    config RELAY_GPIO
        int "RELAY_GPIO"
        range 0 35
        default 21
        help 
            RELAY_GPIO.
endmenu
```
